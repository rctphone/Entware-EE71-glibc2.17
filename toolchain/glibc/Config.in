## toolchain/glibc/Config.in
```kconfig
# Choose glibc version.

choice
	prompt "Glibc Version" if TOOLCHAINOPTS && LIBC_USE_GLIBC
	default GLIBC_USE_VERSION_2_27
	help
	  Select the version of glibc you wish to use.

	config GLIBC_USE_VERSION_2_17
		bool "glibc 2.17"

	config GLIBC_USE_VERSION_2_23
		bool "glibc 2.23"

	config GLIBC_USE_VERSION_2_27
		bool "glibc 2.27"

endchoice
```
